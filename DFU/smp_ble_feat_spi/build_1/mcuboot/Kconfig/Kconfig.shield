## bootloader/sysbuild/3_serial_recovery/1_serial_recovery/build_update/Kconfig/soc/Kconfig.soc
```kconfig
# Load SoC Kconfig descriptions.
osource "C:/ncs/sdk/zephyr/soc/xlnx/zynqmp/Kconfig.soc"
osource "C:/ncs/sdk/zephyr/soc/xlnx/zynq7000/Kconfig.soc"
osource "C:/ncs/sdk/zephyr/soc/xen/Kconfig.soc"
osource "C:/ncs/sdk/zephyr/soc/ti/simplelink/Kconfig.soc"
osource "C:/ncs/sdk/zephyr/soc/ti/lm3s6965/Kconfig.soc"
osource "C:/ncs/sdk/zephyr/soc/ti/k3/Kconfig.soc"
osource "C:/ncs/sdk/zephyr/soc/telink/tlsr/Kconfig.soc"
osource "C:/ncs/sdk/zephyr/soc/starfive/jh71xx/Kconfig.soc"
osource "C:/ncs/sdk/zephyr/soc/st/stm32/Kconfig.soc"
osource "C:/ncs/sdk/zephyr/soc/snps/qemu_arc/Kconfig.soc"
osource "C:/ncs/sdk/zephyr/soc/snps/nsim/arc_v/Kconfig.soc"
osource "C:/ncs/sdk/zephyr/soc/snps/nsim/arc_classic/Kconfig.soc"
osource "C:/ncs/sdk/zephyr/soc/snps/hsdk4xd/Kconfig.soc"
osource "C:/ncs/sdk/zephyr/soc/snps/hsdk/Kconfig.soc"
osource "C:/ncs/sdk/zephyr/soc/snps/emsk/Kconfig.soc"
osource "C:/ncs/sdk/zephyr/soc/snps/emsdp/Kconfig.soc"
osource "C:/ncs/sdk/zephyr/soc/snps/arc_iot/Kconfig.soc"
osource "C:/ncs/sdk/zephyr/soc/silabs/Kconfig.soc"
osource "C:/ncs/sdk/zephyr/soc/sifive/sifive_freedom/Kconfig.soc"
osource "C:/ncs/sdk/zephyr/soc/sensry/Kconfig.soc"
osource "C:/ncs/sdk/zephyr/soc/rockchip/Kconfig.soc"
osource "C:/ncs/sdk/zephyr/soc/renode/riscv_virtual/Kconfig.soc"
osource "C:/ncs/sdk/zephyr/soc/renode/cortex_r8_virtual/Kconfig.soc"
osource "C:/ncs/sdk/zephyr/soc/renesas/smartbond/Kconfig.soc"
osource "C:/ncs/sdk/zephyr/soc/renesas/rzt2m/Kconfig.soc"
osource "C:/ncs/sdk/zephyr/soc/renesas/rcar/Kconfig.soc"
osource "C:/ncs/sdk/zephyr/soc/renesas/ra/Kconfig.soc"
osource "C:/ncs/sdk/zephyr/soc/raspberrypi/Kconfig.soc"
osource "C:/ncs/sdk/zephyr/soc/quicklogic/eos_s3/Kconfig.soc"
osource "C:/ncs/sdk/zephyr/soc/qemu/virt_riscv/Kconfig.soc"
osource "C:/ncs/sdk/zephyr/soc/qemu/malta/Kconfig.soc"
osource "C:/ncs/sdk/zephyr/soc/openisa/rv32m1/Kconfig.soc"
osource "C:/ncs/sdk/zephyr/soc/nxp/s32/Kconfig.soc"
osource "C:/ncs/sdk/zephyr/soc/nxp/rw/Kconfig.soc"
osource "C:/ncs/sdk/zephyr/soc/nxp/mcx/Kconfig.soc"
osource "C:/ncs/sdk/zephyr/soc/nxp/lpc/Kconfig.soc"
osource "C:/ncs/sdk/zephyr/soc/nxp/layerscape/Kconfig.soc"
osource "C:/ncs/sdk/zephyr/soc/nxp/kinetis/Kconfig.soc"
osource "C:/ncs/sdk/zephyr/soc/nxp/imxrt/Kconfig.soc"
osource "C:/ncs/sdk/zephyr/soc/nxp/imx/Kconfig.soc"
osource "C:/ncs/sdk/zephyr/soc/nuvoton/numicro/Kconfig.soc"
osource "C:/ncs/sdk/zephyr/soc/nuvoton/numaker/Kconfig.soc"
osource "C:/ncs/sdk/zephyr/soc/nuvoton/npcx/Kconfig.soc"
osource "C:/ncs/sdk/zephyr/soc/nuvoton/npcm/Kconfig.soc"
osource "C:/ncs/sdk/zephyr/soc/nordic/Kconfig.soc"
osource "C:/ncs/sdk/zephyr/soc/neorv32/Kconfig.soc"
osource "C:/ncs/sdk/zephyr/soc/native/inf_clock/Kconfig.soc"
osource "C:/ncs/sdk/zephyr/soc/microchip/miv/Kconfig.soc"
osource "C:/ncs/sdk/zephyr/soc/microchip/mec/Kconfig.soc"
osource "C:/ncs/sdk/zephyr/soc/mediatek/mtk_adsp/Kconfig.soc"
osource "C:/ncs/sdk/zephyr/soc/lowrisc/opentitan/Kconfig.soc"
osource "C:/ncs/sdk/zephyr/soc/litex/litex_vexriscv/Kconfig.soc"
osource "C:/ncs/sdk/zephyr/soc/ite/ec/Kconfig.soc"
osource "C:/ncs/sdk/zephyr/soc/intel/raptor_lake/Kconfig.soc"
osource "C:/ncs/sdk/zephyr/soc/intel/lakemont/Kconfig.soc"
osource "C:/ncs/sdk/zephyr/soc/intel/intel_socfpga_std/Kconfig.soc"
osource "C:/ncs/sdk/zephyr/soc/intel/intel_socfpga/Kconfig.soc"
osource "C:/ncs/sdk/zephyr/soc/intel/intel_niosv/Kconfig.soc"
osource "C:/ncs/sdk/zephyr/soc/intel/intel_ish/Kconfig.soc"
osource "C:/ncs/sdk/zephyr/soc/intel/intel_adsp/Kconfig.soc"
osource "C:/ncs/sdk/zephyr/soc/intel/elkhart_lake/Kconfig.soc"
osource "C:/ncs/sdk/zephyr/soc/intel/atom/Kconfig.soc"
osource "C:/ncs/sdk/zephyr/soc/intel/apollo_lake/Kconfig.soc"
osource "C:/ncs/sdk/zephyr/soc/intel/alder_lake/Kconfig.soc"
osource "C:/ncs/sdk/zephyr/soc/infineon/cat3/Kconfig.soc"
osource "C:/ncs/sdk/zephyr/soc/infineon/cat1b/Kconfig.soc"
osource "C:/ncs/sdk/zephyr/soc/infineon/cat1a/Kconfig.soc"
osource "C:/ncs/sdk/zephyr/soc/gd/gd32/Kconfig.soc"
osource "C:/ncs/sdk/zephyr/soc/gaisler/leon3/Kconfig.soc"
osource "C:/ncs/sdk/zephyr/soc/gaisler/gr716a/Kconfig.soc"
osource "C:/ncs/sdk/zephyr/soc/espressif/Kconfig.soc"
osource "C:/ncs/sdk/zephyr/soc/ene/kb1200/Kconfig.soc"
osource "C:/ncs/sdk/zephyr/soc/efinix/sapphire/Kconfig.soc"
osource "C:/ncs/sdk/zephyr/soc/cdns/xtensa_sample_controller/Kconfig.soc"
osource "C:/ncs/sdk/zephyr/soc/cdns/dc233c/Kconfig.soc"
osource "C:/ncs/sdk/zephyr/soc/brcm/bcmvk/Kconfig.soc"
osource "C:/ncs/sdk/zephyr/soc/brcm/bcm2712/Kconfig.soc"
osource "C:/ncs/sdk/zephyr/soc/brcm/bcm2711/Kconfig.soc"
osource "C:/ncs/sdk/zephyr/soc/atmel/sam0/Kconfig.soc"
osource "C:/ncs/sdk/zephyr/soc/atmel/sam/Kconfig.soc"
osource "C:/ncs/sdk/zephyr/soc/aspeed/Kconfig.soc"
osource "C:/ncs/sdk/zephyr/soc/arm/Kconfig.soc"
osource "C:/ncs/sdk/zephyr/soc/arm/beetle/Kconfig.soc"
osource "C:/ncs/sdk/zephyr/soc/andestech/Kconfig.soc"
osource "C:/ncs/sdk/zephyr/soc/ambiq/Kconfig.soc"
osource "C:/ncs/sdk/zephyr/soc/altr/zephyr_nios2f/Kconfig.soc"
osource "C:/ncs/sdk/zephyr/soc/altr/qemu_nios2/Kconfig.soc"
osource "C:/ncs/sdk/zephyr/soc/adi/max32/Kconfig.soc"
```
