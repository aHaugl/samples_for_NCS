## DFU/smp_ble_feat_spi/build_1/mcuboot/Kconfig/Kconfig.sysbuild.modules
```kconfig
menu "nrf (C:/Nordic/SDKs/ncs/v2.6.0/nrf)"
osource "C:/Nordic/SDKs/ncs/v2.6.0/nrf/sysbuild/Kconfig.sysbuild"
config ZEPHYR_NRF_MODULE
	bool
	default y
endmenu
```

## bootloader/sysbuild/1_basic/2_chain/build52840/2_chain/Kconfig/boards/Kconfig.sysbuild
```kconfig
# Load Sysbuild board Kconfig descriptions.
osource "C:/ncs/sdk/zephyr/boards/nordic/nrf52840dk/Kconfig.sysbuild"
```

## bootloader/sysbuild/1_basic/2_chain/build52840/Kconfig/arch/Kconfig
```kconfig
# Load Zephyr Arch Kconfig descriptions.
osource "C:/ncs/sdk/zephyr/arch/x86/Kconfig"
osource "C:/ncs/sdk/zephyr/arch/xtensa/Kconfig"
osource "C:/ncs/sdk/zephyr/arch/sparc/Kconfig"
osource "C:/ncs/sdk/zephyr/arch/riscv/Kconfig"
osource "C:/ncs/sdk/zephyr/arch/posix/Kconfig"
osource "C:/ncs/sdk/zephyr/arch/nios2/Kconfig"
osource "C:/ncs/sdk/zephyr/arch/mips/Kconfig"
osource "C:/ncs/sdk/zephyr/arch/arm64/Kconfig"
osource "C:/ncs/sdk/zephyr/arch/arm/Kconfig"
osource "C:/ncs/sdk/zephyr/arch/arc/Kconfig"
```

## bootloader/sysbuild/1_basic/2_chain/build52840/Kconfig/boards/Kconfig.nrf52840dk
```kconfig
# Load board Kconfig descriptions.
osource "C:/ncs/sdk/zephyr/boards/nordic/nrf52840dk/Kconfig.nrf52840dk"
```

## bootloader/sysbuild/1_basic/2_chain/build52840/Kconfig/soc/Kconfig.sysbuild
```kconfig
# Load Sysbuild SoC Kconfig descriptions.
osource "C:/ncs/sdk/zephyr/soc/xlnx/zynqmp/Kconfig.sysbuild"
osource "C:/ncs/sdk/zephyr/soc/xlnx/zynq7000/Kconfig.sysbuild"
osource "C:/ncs/sdk/zephyr/soc/xen/Kconfig.sysbuild"
osource "C:/ncs/sdk/zephyr/soc/wch/ch32v00x/Kconfig.sysbuild"
osource "C:/ncs/sdk/zephyr/soc/ti/simplelink/Kconfig.sysbuild"
osource "C:/ncs/sdk/zephyr/soc/ti/lm3s6965/Kconfig.sysbuild"
osource "C:/ncs/sdk/zephyr/soc/ti/k3/Kconfig.sysbuild"
osource "C:/ncs/sdk/zephyr/soc/telink/tlsr/Kconfig.sysbuild"
osource "C:/ncs/sdk/zephyr/soc/starfive/jh71xx/Kconfig.sysbuild"
osource "C:/ncs/sdk/zephyr/soc/st/stm32/Kconfig.sysbuild"
osource "C:/ncs/sdk/zephyr/soc/snps/qemu_arc/Kconfig.sysbuild"
osource "C:/ncs/sdk/zephyr/soc/snps/nsim/arc_v/Kconfig.sysbuild"
osource "C:/ncs/sdk/zephyr/soc/snps/nsim/arc_classic/Kconfig.sysbuild"
osource "C:/ncs/sdk/zephyr/soc/snps/hsdk4xd/Kconfig.sysbuild"
osource "C:/ncs/sdk/zephyr/soc/snps/hsdk/Kconfig.sysbuild"
osource "C:/ncs/sdk/zephyr/soc/snps/emsk/Kconfig.sysbuild"
osource "C:/ncs/sdk/zephyr/soc/snps/emsdp/Kconfig.sysbuild"
osource "C:/ncs/sdk/zephyr/soc/snps/arc_iot/Kconfig.sysbuild"
osource "C:/ncs/sdk/zephyr/soc/silabs/Kconfig.sysbuild"
osource "C:/ncs/sdk/zephyr/soc/sifive/sifive_freedom/Kconfig.sysbuild"
osource "C:/ncs/sdk/zephyr/soc/sensry/Kconfig.sysbuild"
osource "C:/ncs/sdk/zephyr/soc/rockchip/Kconfig.sysbuild"
osource "C:/ncs/sdk/zephyr/soc/renode/riscv_virtual/Kconfig.sysbuild"
osource "C:/ncs/sdk/zephyr/soc/renode/cortex_r8_virtual/Kconfig.sysbuild"
osource "C:/ncs/sdk/zephyr/soc/renesas/smartbond/Kconfig.sysbuild"
osource "C:/ncs/sdk/zephyr/soc/renesas/rzt2m/Kconfig.sysbuild"
osource "C:/ncs/sdk/zephyr/soc/renesas/rz/Kconfig.sysbuild"
osource "C:/ncs/sdk/zephyr/soc/renesas/rcar/Kconfig.sysbuild"
osource "C:/ncs/sdk/zephyr/soc/renesas/ra/Kconfig.sysbuild"
osource "C:/ncs/sdk/zephyr/soc/realtek/ec/Kconfig.sysbuild"
osource "C:/ncs/sdk/zephyr/soc/raspberrypi/rpi_pico/Kconfig.sysbuild"
osource "C:/ncs/sdk/zephyr/soc/quicklogic/eos_s3/Kconfig.sysbuild"
osource "C:/ncs/sdk/zephyr/soc/qemu/virt_riscv/Kconfig.sysbuild"
osource "C:/ncs/sdk/zephyr/soc/qemu/malta/Kconfig.sysbuild"
osource "C:/ncs/sdk/zephyr/soc/openisa/rv32m1/Kconfig.sysbuild"
osource "C:/ncs/sdk/zephyr/soc/nxp/s32/Kconfig.sysbuild"
osource "C:/ncs/sdk/zephyr/soc/nxp/rw/Kconfig.sysbuild"
osource "C:/ncs/sdk/zephyr/soc/nxp/mcx/Kconfig.sysbuild"
osource "C:/ncs/sdk/zephyr/soc/nxp/lpc/Kconfig.sysbuild"
osource "C:/ncs/sdk/zephyr/soc/nxp/layerscape/Kconfig.sysbuild"
osource "C:/ncs/sdk/zephyr/soc/nxp/kinetis/Kconfig.sysbuild"
osource "C:/ncs/sdk/zephyr/soc/nxp/imxrt/Kconfig.sysbuild"
osource "C:/ncs/sdk/zephyr/soc/nxp/imx/Kconfig.sysbuild"
osource "C:/ncs/sdk/zephyr/soc/nuvoton/numicro/Kconfig.sysbuild"
osource "C:/ncs/sdk/zephyr/soc/nuvoton/numaker/Kconfig.sysbuild"
osource "C:/ncs/sdk/zephyr/soc/nuvoton/npcx/Kconfig.sysbuild"
osource "C:/ncs/sdk/zephyr/soc/nuvoton/npcm/Kconfig.sysbuild"
osource "C:/ncs/sdk/zephyr/soc/nordic/Kconfig.sysbuild"
osource "C:/ncs/sdk/zephyr/soc/neorv32/Kconfig.sysbuild"
osource "C:/ncs/sdk/zephyr/soc/native/inf_clock/Kconfig.sysbuild"
osource "C:/ncs/sdk/zephyr/soc/microchip/miv/Kconfig.sysbuild"
osource "C:/ncs/sdk/zephyr/soc/microchip/mec/Kconfig.sysbuild"
osource "C:/ncs/sdk/zephyr/soc/mediatek/mt8xxx/Kconfig.sysbuild"
osource "C:/ncs/sdk/zephyr/soc/lowrisc/opentitan/Kconfig.sysbuild"
osource "C:/ncs/sdk/zephyr/soc/litex/litex_vexriscv/Kconfig.sysbuild"
osource "C:/ncs/sdk/zephyr/soc/ite/ec/Kconfig.sysbuild"
osource "C:/ncs/sdk/zephyr/soc/intel/raptor_lake/Kconfig.sysbuild"
osource "C:/ncs/sdk/zephyr/soc/intel/lakemont/Kconfig.sysbuild"
osource "C:/ncs/sdk/zephyr/soc/intel/intel_socfpga_std/Kconfig.sysbuild"
osource "C:/ncs/sdk/zephyr/soc/intel/intel_socfpga/Kconfig.sysbuild"
osource "C:/ncs/sdk/zephyr/soc/intel/intel_niosv/Kconfig.sysbuild"
osource "C:/ncs/sdk/zephyr/soc/intel/intel_ish/Kconfig.sysbuild"
osource "C:/ncs/sdk/zephyr/soc/intel/intel_adsp/Kconfig.sysbuild"
osource "C:/ncs/sdk/zephyr/soc/intel/elkhart_lake/Kconfig.sysbuild"
osource "C:/ncs/sdk/zephyr/soc/intel/atom/Kconfig.sysbuild"
osource "C:/ncs/sdk/zephyr/soc/intel/apollo_lake/Kconfig.sysbuild"
osource "C:/ncs/sdk/zephyr/soc/intel/alder_lake/Kconfig.sysbuild"
osource "C:/ncs/sdk/zephyr/soc/infineon/cat3/Kconfig.sysbuild"
osource "C:/ncs/sdk/zephyr/soc/infineon/cat1b/Kconfig.sysbuild"
osource "C:/ncs/sdk/zephyr/soc/infineon/cat1a/Kconfig.sysbuild"
osource "C:/ncs/sdk/zephyr/soc/gd/gd32/Kconfig.sysbuild"
osource "C:/ncs/sdk/zephyr/soc/gaisler/leon3/Kconfig.sysbuild"
osource "C:/ncs/sdk/zephyr/soc/gaisler/gr716a/Kconfig.sysbuild"
osource "C:/ncs/sdk/zephyr/soc/espressif/Kconfig.sysbuild"
osource "C:/ncs/sdk/zephyr/soc/ene/kb1200/Kconfig.sysbuild"
osource "C:/ncs/sdk/zephyr/soc/efinix/sapphire/Kconfig.sysbuild"
osource "C:/ncs/sdk/zephyr/soc/cdns/xtensa_sample_controller/Kconfig.sysbuild"
osource "C:/ncs/sdk/zephyr/soc/cdns/sample_controller32/Kconfig.sysbuild"
osource "C:/ncs/sdk/zephyr/soc/cdns/dc233c/Kconfig.sysbuild"
osource "C:/ncs/sdk/zephyr/soc/brcm/bcmvk/Kconfig.sysbuild"
osource "C:/ncs/sdk/zephyr/soc/brcm/bcm2712/Kconfig.sysbuild"
osource "C:/ncs/sdk/zephyr/soc/brcm/bcm2711/Kconfig.sysbuild"
osource "C:/ncs/sdk/zephyr/soc/atmel/sam0/Kconfig.sysbuild"
osource "C:/ncs/sdk/zephyr/soc/atmel/sam/Kconfig.sysbuild"
osource "C:/ncs/sdk/zephyr/soc/aspeed/Kconfig.sysbuild"
osource "C:/ncs/sdk/zephyr/soc/arm/Kconfig.sysbuild"
osource "C:/ncs/sdk/zephyr/soc/arm/beetle/Kconfig.sysbuild"
osource "C:/ncs/sdk/zephyr/soc/andestech/Kconfig.sysbuild"
osource "C:/ncs/sdk/zephyr/soc/amd/acp_6_0/Kconfig.sysbuild"
osource "C:/ncs/sdk/zephyr/soc/ambiq/Kconfig.sysbuild"
osource "C:/ncs/sdk/zephyr/soc/altr/zephyr_nios2f/Kconfig.sysbuild"
osource "C:/ncs/sdk/zephyr/soc/altr/qemu_nios2/Kconfig.sysbuild"
osource "C:/ncs/sdk/zephyr/soc/adi/max32/Kconfig.sysbuild"
osource "C:/ncs/sdk/nrf/soc/nordic/Kconfig.sysbuild"
```

## bootloader/sysbuild/1_basic/2_chain/build52840/mcuboot/Kconfig/boards/Kconfig.defconfig
```kconfig
# Load Zephyr board defconfig descriptions.
osource "C:/ncs/sdk/zephyr/boards/nordic/nrf52840dk/Kconfig.defconfig"
```

## bootloader/sysbuild/1_basic/2_chain/build52840/s1_image/Kconfig/soc/Kconfig.defconfig
```kconfig
# Load Zephyr SoC defconfig descriptions.
osource "C:/ncs/sdk/zephyr/soc/xlnx/zynqmp/Kconfig.defconfig"
osource "C:/ncs/sdk/zephyr/soc/xlnx/zynq7000/Kconfig.defconfig"
osource "C:/ncs/sdk/zephyr/soc/xen/Kconfig.defconfig"
osource "C:/ncs/sdk/zephyr/soc/wch/ch32v00x/Kconfig.defconfig"
osource "C:/ncs/sdk/zephyr/soc/ti/simplelink/Kconfig.defconfig"
osource "C:/ncs/sdk/zephyr/soc/ti/lm3s6965/Kconfig.defconfig"
osource "C:/ncs/sdk/zephyr/soc/ti/k3/Kconfig.defconfig"
osource "C:/ncs/sdk/zephyr/soc/telink/tlsr/Kconfig.defconfig"
osource "C:/ncs/sdk/zephyr/soc/starfive/jh71xx/Kconfig.defconfig"
osource "C:/ncs/sdk/zephyr/soc/st/stm32/Kconfig.defconfig"
osource "C:/ncs/sdk/zephyr/soc/snps/qemu_arc/Kconfig.defconfig"
osource "C:/ncs/sdk/zephyr/soc/snps/nsim/arc_v/Kconfig.defconfig"
osource "C:/ncs/sdk/zephyr/soc/snps/nsim/arc_classic/Kconfig.defconfig"
osource "C:/ncs/sdk/zephyr/soc/snps/hsdk4xd/Kconfig.defconfig"
osource "C:/ncs/sdk/zephyr/soc/snps/hsdk/Kconfig.defconfig"
osource "C:/ncs/sdk/zephyr/soc/snps/emsk/Kconfig.defconfig"
osource "C:/ncs/sdk/zephyr/soc/snps/emsdp/Kconfig.defconfig"
osource "C:/ncs/sdk/zephyr/soc/snps/arc_iot/Kconfig.defconfig"
osource "C:/ncs/sdk/zephyr/soc/silabs/Kconfig.defconfig"
osource "C:/ncs/sdk/zephyr/soc/sifive/sifive_freedom/Kconfig.defconfig"
osource "C:/ncs/sdk/zephyr/soc/sensry/Kconfig.defconfig"
osource "C:/ncs/sdk/zephyr/soc/rockchip/Kconfig.defconfig"
osource "C:/ncs/sdk/zephyr/soc/renode/riscv_virtual/Kconfig.defconfig"
osource "C:/ncs/sdk/zephyr/soc/renode/cortex_r8_virtual/Kconfig.defconfig"
osource "C:/ncs/sdk/zephyr/soc/renesas/smartbond/Kconfig.defconfig"
osource "C:/ncs/sdk/zephyr/soc/renesas/rzt2m/Kconfig.defconfig"
osource "C:/ncs/sdk/zephyr/soc/renesas/rz/Kconfig.defconfig"
osource "C:/ncs/sdk/zephyr/soc/renesas/rcar/Kconfig.defconfig"
osource "C:/ncs/sdk/zephyr/soc/renesas/ra/Kconfig.defconfig"
osource "C:/ncs/sdk/zephyr/soc/realtek/ec/Kconfig.defconfig"
osource "C:/ncs/sdk/zephyr/soc/raspberrypi/rpi_pico/Kconfig.defconfig"
osource "C:/ncs/sdk/zephyr/soc/quicklogic/eos_s3/Kconfig.defconfig"
osource "C:/ncs/sdk/zephyr/soc/qemu/virt_riscv/Kconfig.defconfig"
osource "C:/ncs/sdk/zephyr/soc/qemu/malta/Kconfig.defconfig"
osource "C:/ncs/sdk/zephyr/soc/openisa/rv32m1/Kconfig.defconfig"
osource "C:/ncs/sdk/zephyr/soc/nxp/s32/Kconfig.defconfig"
osource "C:/ncs/sdk/zephyr/soc/nxp/rw/Kconfig.defconfig"
osource "C:/ncs/sdk/zephyr/soc/nxp/mcx/Kconfig.defconfig"
osource "C:/ncs/sdk/zephyr/soc/nxp/lpc/Kconfig.defconfig"
osource "C:/ncs/sdk/zephyr/soc/nxp/layerscape/Kconfig.defconfig"
osource "C:/ncs/sdk/zephyr/soc/nxp/kinetis/Kconfig.defconfig"
osource "C:/ncs/sdk/zephyr/soc/nxp/imxrt/Kconfig.defconfig"
osource "C:/ncs/sdk/zephyr/soc/nxp/imx/Kconfig.defconfig"
osource "C:/ncs/sdk/zephyr/soc/nuvoton/numicro/Kconfig.defconfig"
osource "C:/ncs/sdk/zephyr/soc/nuvoton/numaker/Kconfig.defconfig"
osource "C:/ncs/sdk/zephyr/soc/nuvoton/npcx/Kconfig.defconfig"
osource "C:/ncs/sdk/zephyr/soc/nuvoton/npcm/Kconfig.defconfig"
osource "C:/ncs/sdk/zephyr/soc/nordic/Kconfig.defconfig"
osource "C:/ncs/sdk/zephyr/soc/neorv32/Kconfig.defconfig"
osource "C:/ncs/sdk/zephyr/soc/native/inf_clock/Kconfig.defconfig"
osource "C:/ncs/sdk/zephyr/soc/microchip/miv/Kconfig.defconfig"
osource "C:/ncs/sdk/zephyr/soc/microchip/mec/Kconfig.defconfig"
osource "C:/ncs/sdk/zephyr/soc/mediatek/mt8xxx/Kconfig.defconfig"
osource "C:/ncs/sdk/zephyr/soc/lowrisc/opentitan/Kconfig.defconfig"
osource "C:/ncs/sdk/zephyr/soc/litex/litex_vexriscv/Kconfig.defconfig"
osource "C:/ncs/sdk/zephyr/soc/ite/ec/Kconfig.defconfig"
osource "C:/ncs/sdk/zephyr/soc/intel/raptor_lake/Kconfig.defconfig"
osource "C:/ncs/sdk/zephyr/soc/intel/lakemont/Kconfig.defconfig"
osource "C:/ncs/sdk/zephyr/soc/intel/intel_socfpga_std/Kconfig.defconfig"
osource "C:/ncs/sdk/zephyr/soc/intel/intel_socfpga/Kconfig.defconfig"
osource "C:/ncs/sdk/zephyr/soc/intel/intel_niosv/Kconfig.defconfig"
osource "C:/ncs/sdk/zephyr/soc/intel/intel_ish/Kconfig.defconfig"
osource "C:/ncs/sdk/zephyr/soc/intel/intel_adsp/Kconfig.defconfig"
osource "C:/ncs/sdk/zephyr/soc/intel/elkhart_lake/Kconfig.defconfig"
osource "C:/ncs/sdk/zephyr/soc/intel/atom/Kconfig.defconfig"
osource "C:/ncs/sdk/zephyr/soc/intel/apollo_lake/Kconfig.defconfig"
osource "C:/ncs/sdk/zephyr/soc/intel/alder_lake/Kconfig.defconfig"
osource "C:/ncs/sdk/zephyr/soc/infineon/cat3/Kconfig.defconfig"
osource "C:/ncs/sdk/zephyr/soc/infineon/cat1b/Kconfig.defconfig"
osource "C:/ncs/sdk/zephyr/soc/infineon/cat1a/Kconfig.defconfig"
osource "C:/ncs/sdk/zephyr/soc/gd/gd32/Kconfig.defconfig"
osource "C:/ncs/sdk/zephyr/soc/gaisler/leon3/Kconfig.defconfig"
osource "C:/ncs/sdk/zephyr/soc/gaisler/gr716a/Kconfig.defconfig"
osource "C:/ncs/sdk/zephyr/soc/espressif/Kconfig.defconfig"
osource "C:/ncs/sdk/zephyr/soc/ene/kb1200/Kconfig.defconfig"
osource "C:/ncs/sdk/zephyr/soc/efinix/sapphire/Kconfig.defconfig"
osource "C:/ncs/sdk/zephyr/soc/cdns/xtensa_sample_controller/Kconfig.defconfig"
osource "C:/ncs/sdk/zephyr/soc/cdns/sample_controller32/Kconfig.defconfig"
osource "C:/ncs/sdk/zephyr/soc/cdns/dc233c/Kconfig.defconfig"
osource "C:/ncs/sdk/zephyr/soc/brcm/bcmvk/Kconfig.defconfig"
osource "C:/ncs/sdk/zephyr/soc/brcm/bcm2712/Kconfig.defconfig"
osource "C:/ncs/sdk/zephyr/soc/brcm/bcm2711/Kconfig.defconfig"
osource "C:/ncs/sdk/zephyr/soc/atmel/sam0/Kconfig.defconfig"
osource "C:/ncs/sdk/zephyr/soc/atmel/sam/Kconfig.defconfig"
osource "C:/ncs/sdk/zephyr/soc/aspeed/Kconfig.defconfig"
osource "C:/ncs/sdk/zephyr/soc/arm/Kconfig.defconfig"
osource "C:/ncs/sdk/zephyr/soc/arm/beetle/Kconfig.defconfig"
osource "C:/ncs/sdk/zephyr/soc/andestech/Kconfig.defconfig"
osource "C:/ncs/sdk/zephyr/soc/amd/acp_6_0/Kconfig.defconfig"
osource "C:/ncs/sdk/zephyr/soc/ambiq/Kconfig.defconfig"
osource "C:/ncs/sdk/zephyr/soc/altr/zephyr_nios2f/Kconfig.defconfig"
osource "C:/ncs/sdk/zephyr/soc/altr/qemu_nios2/Kconfig.defconfig"
osource "C:/ncs/sdk/zephyr/soc/adi/max32/Kconfig.defconfig"
osource "C:/ncs/sdk/nrf/soc/nordic/Kconfig.defconfig"
```
