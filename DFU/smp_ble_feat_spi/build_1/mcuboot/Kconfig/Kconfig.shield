## bootloader/sysbuild/3_serial_recovery/1_serial_recovery/build_update/1_serial_recovery/Kconfig/Kconfig.modules
```kconfig
menu "nrf (C:/ncs/sdk/nrf)"
osource "C:/ncs/sdk/nrf/Kconfig.nrf"
config ZEPHYR_NRF_MODULE
	bool
	default y
endmenu
menu "mcuboot (C:/ncs/sdk/bootloader/mcuboot)"
osource "$(ZEPHYR_MCUBOOT_KCONFIG)"
config ZEPHYR_MCUBOOT_MODULE
	bool
	default y
endmenu
menu "mbedtls (C:/ncs/sdk/modules/crypto/mbedtls)"
osource "$(ZEPHYR_MBEDTLS_KCONFIG)"
config ZEPHYR_MBEDTLS_MODULE
	bool
	default y
endmenu
menu "oberon-psa-crypto (C:/ncs/sdk/modules/crypto/oberon-psa-crypto)"
osource "C:/ncs/sdk/modules/crypto/oberon-psa-crypto/Kconfig.oberon_psa_crypto"
config ZEPHYR_OBERON_PSA_CRYPTO_MODULE
	bool
	default y
endmenu
menu "trusted-firmware-m (C:/ncs/sdk/modules/tee/tf-m/trusted-firmware-m)"
osource "$(ZEPHYR_TRUSTED_FIRMWARE_M_KCONFIG)"
config ZEPHYR_TRUSTED_FIRMWARE_M_MODULE
	bool
	default y
endmenu
config ZEPHYR_PSA_ARCH_TESTS_MODULE
	bool
	default y
config ZEPHYR_SOC_HWMV1_MODULE
	bool
	default y
menu "cjson (C:/ncs/sdk/modules/lib/cjson)"
osource "$(ZEPHYR_CJSON_KCONFIG)"
config ZEPHYR_CJSON_MODULE
	bool
	default y
endmenu
menu "azure-sdk-for-c (C:/ncs/sdk/modules/lib/azure-sdk-for-c)"
osource "$(ZEPHYR_AZURE_SDK_FOR_C_KCONFIG)"
config ZEPHYR_AZURE_SDK_FOR_C_MODULE
	bool
	default y
endmenu
menu "cirrus-logic (C:/ncs/sdk/modules/hal/cirrus-logic)"
osource "C:/ncs/sdk/modules/hal/cirrus-logic/Kconfig"
config ZEPHYR_CIRRUS_LOGIC_MODULE
	bool
	default y
endmenu
menu "openthread (C:/ncs/sdk/modules/lib/openthread)"
osource "$(ZEPHYR_OPENTHREAD_KCONFIG)"
config ZEPHYR_OPENTHREAD_MODULE
	bool
	default y
endmenu
menu "suit-generator (C:/ncs/sdk/modules/lib/suit-generator)"
osource "C:/ncs/sdk/modules/lib/suit-generator/ncs/Kconfig"
config ZEPHYR_SUIT_GENERATOR_MODULE
	bool
	default y
endmenu
menu "suit-processor (C:/ncs/sdk/modules/lib/suit-processor)"
osource "C:/ncs/sdk/modules/lib/suit-processor/Kconfig"
config ZEPHYR_SUIT_PROCESSOR_MODULE
	bool
	default y
endmenu
menu "memfault-firmware-sdk (C:/ncs/sdk/modules/lib/memfault-firmware-sdk)"
osource "C:/ncs/sdk/modules/lib/memfault-firmware-sdk/ports/zephyr/Kconfig"
config ZEPHYR_MEMFAULT_FIRMWARE_SDK_MODULE
	bool
	default y
endmenu
menu "coremark (C:/ncs/sdk/modules/benchmark/coremark)"
osource "$(ZEPHYR_COREMARK_KCONFIG)"
config ZEPHYR_COREMARK_MODULE
	bool
	default y
endmenu
menu "canopennode (C:/ncs/sdk/modules/lib/canopennode)"
osource "$(ZEPHYR_CANOPENNODE_KCONFIG)"
config ZEPHYR_CANOPENNODE_MODULE
	bool
	default y
endmenu
menu "chre (C:/ncs/sdk/modules/lib/chre)"
osource "C:/ncs/sdk/modules/lib/chre/platform/zephyr/Kconfig"
config ZEPHYR_CHRE_MODULE
	bool
	default y
endmenu
menu "lz4 (C:/ncs/sdk/modules/lib/lz4)"
osource "$(ZEPHYR_LZ4_KCONFIG)"
config ZEPHYR_LZ4_MODULE
	bool
	default y
endmenu
menu "nanopb (C:/ncs/sdk/modules/lib/nanopb)"
osource "$(ZEPHYR_NANOPB_KCONFIG)"
config ZEPHYR_NANOPB_MODULE
	bool
	default y
endmenu
config ZEPHYR_TF_M_TESTS_MODULE
	bool
	default y
menu "zscilib (C:/ncs/sdk/modules/lib/zscilib)"
osource "C:/ncs/sdk/modules/lib/zscilib/Kconfig.zscilib"
config ZEPHYR_ZSCILIB_MODULE
	bool
	default y
endmenu
menu "cmsis (C:/ncs/sdk/modules/hal/cmsis)"
osource "$(ZEPHYR_CMSIS_KCONFIG)"
config ZEPHYR_CMSIS_MODULE
	bool
	default y
endmenu
menu "cmsis-dsp (C:/ncs/sdk/modules/lib/cmsis-dsp)"
osource "$(ZEPHYR_CMSIS_DSP_KCONFIG)"
config ZEPHYR_CMSIS_DSP_MODULE
	bool
	default y
endmenu
menu "cmsis-nn (C:/ncs/sdk/modules/lib/cmsis-nn)"
osource "$(ZEPHYR_CMSIS_NN_KCONFIG)"
config ZEPHYR_CMSIS_NN_MODULE
	bool
	default y
endmenu
menu "fatfs (C:/ncs/sdk/modules/fs/fatfs)"
osource "$(ZEPHYR_FATFS_KCONFIG)"
config ZEPHYR_FATFS_MODULE
	bool
	default y
endmenu
menu "hal_nordic (C:/ncs/sdk/modules/hal/nordic)"
osource "$(ZEPHYR_HAL_NORDIC_KCONFIG)"
config ZEPHYR_HAL_NORDIC_MODULE
	bool
	default y

config ZEPHYR_HAL_NORDIC_MODULE_BLOBS
	bool
endmenu
menu "hal_st (C:/ncs/sdk/modules/hal/st)"
osource "$(ZEPHYR_HAL_ST_KCONFIG)"
config ZEPHYR_HAL_ST_MODULE
	bool
	default y
endmenu
config ZEPHYR_HAL_WURTHELEKTRONIK_MODULE
	bool
	default y
menu "hostap (C:/ncs/sdk/modules/lib/hostap)"
osource "$(ZEPHYR_HOSTAP_KCONFIG)"
config ZEPHYR_HOSTAP_MODULE
	bool
	default y
endmenu
config ZEPHYR_LIBMETAL_MODULE
	bool
	default y
menu "liblc3 (C:/ncs/sdk/modules/lib/liblc3)"
osource "$(ZEPHYR_LIBLC3_KCONFIG)"
config ZEPHYR_LIBLC3_MODULE
	bool
	default y
endmenu
menu "littlefs (C:/ncs/sdk/modules/fs/littlefs)"
osource "$(ZEPHYR_LITTLEFS_KCONFIG)"
config ZEPHYR_LITTLEFS_MODULE
	bool
	default y
endmenu
menu "loramac-node (C:/ncs/sdk/modules/lib/loramac-node)"
osource "$(ZEPHYR_LORAMAC_NODE_KCONFIG)"
config ZEPHYR_LORAMAC_NODE_MODULE
	bool
	default y
endmenu
menu "lvgl (C:/ncs/sdk/modules/lib/gui/lvgl)"
osource "C:/ncs/sdk/modules/lib/gui/lvgl/Kconfig"
config ZEPHYR_LVGL_MODULE
	bool
	default y
endmenu
config ZEPHYR_MIPI_SYS_T_MODULE
	bool
	default y
menu "nrf_wifi (C:/ncs/sdk/modules/lib/nrf_wifi)"
osource "$(ZEPHYR_NRF_WIFI_KCONFIG)"
config ZEPHYR_NRF_WIFI_MODULE
	bool
	default y

config ZEPHYR_NRF_WIFI_MODULE_BLOBS
	bool
endmenu
config ZEPHYR_OPEN_AMP_MODULE
	bool
	default y
menu "picolibc (C:/ncs/sdk/modules/lib/picolibc)"
osource "C:/ncs/sdk/modules/lib/picolibc/zephyr/Kconfig"
config ZEPHYR_PICOLIBC_MODULE
	bool
	default y
endmenu
menu "segger (C:/ncs/sdk/modules/debug/segger)"
osource "$(ZEPHYR_SEGGER_KCONFIG)"
config ZEPHYR_SEGGER_MODULE
	bool
	default y
endmenu
config ZEPHYR_TINYCRYPT_MODULE
	bool
	default y
menu "uoscore-uedhoc (C:/ncs/sdk/modules/lib/uoscore-uedhoc)"
osource "$(ZEPHYR_UOSCORE_UEDHOC_KCONFIG)"
config ZEPHYR_UOSCORE_UEDHOC_MODULE
	bool
	default y
endmenu
menu "zcbor (C:/ncs/sdk/modules/lib/zcbor)"
osource "$(ZEPHYR_ZCBOR_KCONFIG)"
config ZEPHYR_ZCBOR_MODULE
	bool
	default y
endmenu
menu "nrfxlib (C:/ncs/sdk/nrfxlib)"
osource "C:/ncs/sdk/nrfxlib/Kconfig.nrfxlib"
config ZEPHYR_NRFXLIB_MODULE
	bool
	default y
endmenu
config ZEPHYR_NRF_HW_MODELS_MODULE
	bool
	default y
menu "connectedhomeip (C:/ncs/sdk/modules/lib/matter)"
osource "C:/ncs/sdk/modules/lib/matter/config/nrfconnect/chip-module/Kconfig"
config ZEPHYR_CONNECTEDHOMEIP_MODULE
	bool
	default y
endmenu
```

## bootloader/sysbuild/3_serial_recovery/1_serial_recovery/build_update/Kconfig/soc/Kconfig
```kconfig
# Load Zephyr SoC Kconfig descriptions.
osource "C:/ncs/sdk/zephyr/soc/xlnx/zynqmp/Kconfig"
osource "C:/ncs/sdk/zephyr/soc/xlnx/zynq7000/Kconfig"
osource "C:/ncs/sdk/zephyr/soc/xen/Kconfig"
osource "C:/ncs/sdk/zephyr/soc/ti/simplelink/Kconfig"
osource "C:/ncs/sdk/zephyr/soc/ti/lm3s6965/Kconfig"
osource "C:/ncs/sdk/zephyr/soc/ti/k3/Kconfig"
osource "C:/ncs/sdk/zephyr/soc/telink/tlsr/Kconfig"
osource "C:/ncs/sdk/zephyr/soc/starfive/jh71xx/Kconfig"
osource "C:/ncs/sdk/zephyr/soc/st/stm32/Kconfig"
osource "C:/ncs/sdk/zephyr/soc/snps/qemu_arc/Kconfig"
osource "C:/ncs/sdk/zephyr/soc/snps/nsim/arc_v/Kconfig"
osource "C:/ncs/sdk/zephyr/soc/snps/nsim/arc_classic/Kconfig"
osource "C:/ncs/sdk/zephyr/soc/snps/hsdk4xd/Kconfig"
osource "C:/ncs/sdk/zephyr/soc/snps/hsdk/Kconfig"
osource "C:/ncs/sdk/zephyr/soc/snps/emsk/Kconfig"
osource "C:/ncs/sdk/zephyr/soc/snps/emsdp/Kconfig"
osource "C:/ncs/sdk/zephyr/soc/snps/arc_iot/Kconfig"
osource "C:/ncs/sdk/zephyr/soc/silabs/Kconfig"
osource "C:/ncs/sdk/zephyr/soc/sifive/sifive_freedom/Kconfig"
osource "C:/ncs/sdk/zephyr/soc/sensry/Kconfig"
osource "C:/ncs/sdk/zephyr/soc/rockchip/Kconfig"
osource "C:/ncs/sdk/zephyr/soc/renode/riscv_virtual/Kconfig"
osource "C:/ncs/sdk/zephyr/soc/renode/cortex_r8_virtual/Kconfig"
osource "C:/ncs/sdk/zephyr/soc/renesas/smartbond/Kconfig"
osource "C:/ncs/sdk/zephyr/soc/renesas/rzt2m/Kconfig"
osource "C:/ncs/sdk/zephyr/soc/renesas/rcar/Kconfig"
osource "C:/ncs/sdk/zephyr/soc/renesas/ra/Kconfig"
osource "C:/ncs/sdk/zephyr/soc/raspberrypi/Kconfig"
osource "C:/ncs/sdk/zephyr/soc/quicklogic/eos_s3/Kconfig"
osource "C:/ncs/sdk/zephyr/soc/qemu/virt_riscv/Kconfig"
osource "C:/ncs/sdk/zephyr/soc/qemu/malta/Kconfig"
osource "C:/ncs/sdk/zephyr/soc/openisa/rv32m1/Kconfig"
osource "C:/ncs/sdk/zephyr/soc/nxp/s32/Kconfig"
osource "C:/ncs/sdk/zephyr/soc/nxp/rw/Kconfig"
osource "C:/ncs/sdk/zephyr/soc/nxp/mcx/Kconfig"
osource "C:/ncs/sdk/zephyr/soc/nxp/lpc/Kconfig"
osource "C:/ncs/sdk/zephyr/soc/nxp/layerscape/Kconfig"
osource "C:/ncs/sdk/zephyr/soc/nxp/kinetis/Kconfig"
osource "C:/ncs/sdk/zephyr/soc/nxp/imxrt/Kconfig"
osource "C:/ncs/sdk/zephyr/soc/nxp/imx/Kconfig"
osource "C:/ncs/sdk/zephyr/soc/nuvoton/numicro/Kconfig"
osource "C:/ncs/sdk/zephyr/soc/nuvoton/numaker/Kconfig"
osource "C:/ncs/sdk/zephyr/soc/nuvoton/npcx/Kconfig"
osource "C:/ncs/sdk/zephyr/soc/nuvoton/npcm/Kconfig"
osource "C:/ncs/sdk/zephyr/soc/nordic/Kconfig"
osource "C:/ncs/sdk/zephyr/soc/neorv32/Kconfig"
osource "C:/ncs/sdk/zephyr/soc/native/inf_clock/Kconfig"
osource "C:/ncs/sdk/zephyr/soc/microchip/miv/Kconfig"
osource "C:/ncs/sdk/zephyr/soc/microchip/mec/Kconfig"
osource "C:/ncs/sdk/zephyr/soc/mediatek/mtk_adsp/Kconfig"
osource "C:/ncs/sdk/zephyr/soc/lowrisc/opentitan/Kconfig"
osource "C:/ncs/sdk/zephyr/soc/litex/litex_vexriscv/Kconfig"
osource "C:/ncs/sdk/zephyr/soc/ite/ec/Kconfig"
osource "C:/ncs/sdk/zephyr/soc/intel/raptor_lake/Kconfig"
osource "C:/ncs/sdk/zephyr/soc/intel/lakemont/Kconfig"
osource "C:/ncs/sdk/zephyr/soc/intel/intel_socfpga_std/Kconfig"
osource "C:/ncs/sdk/zephyr/soc/intel/intel_socfpga/Kconfig"
osource "C:/ncs/sdk/zephyr/soc/intel/intel_niosv/Kconfig"
osource "C:/ncs/sdk/zephyr/soc/intel/intel_ish/Kconfig"
osource "C:/ncs/sdk/zephyr/soc/intel/intel_adsp/Kconfig"
osource "C:/ncs/sdk/zephyr/soc/intel/elkhart_lake/Kconfig"
osource "C:/ncs/sdk/zephyr/soc/intel/atom/Kconfig"
osource "C:/ncs/sdk/zephyr/soc/intel/apollo_lake/Kconfig"
osource "C:/ncs/sdk/zephyr/soc/intel/alder_lake/Kconfig"
osource "C:/ncs/sdk/zephyr/soc/infineon/cat3/Kconfig"
osource "C:/ncs/sdk/zephyr/soc/infineon/cat1b/Kconfig"
osource "C:/ncs/sdk/zephyr/soc/infineon/cat1a/Kconfig"
osource "C:/ncs/sdk/zephyr/soc/gd/gd32/Kconfig"
osource "C:/ncs/sdk/zephyr/soc/gaisler/leon3/Kconfig"
osource "C:/ncs/sdk/zephyr/soc/gaisler/gr716a/Kconfig"
osource "C:/ncs/sdk/zephyr/soc/espressif/Kconfig"
osource "C:/ncs/sdk/zephyr/soc/ene/kb1200/Kconfig"
osource "C:/ncs/sdk/zephyr/soc/efinix/sapphire/Kconfig"
osource "C:/ncs/sdk/zephyr/soc/cdns/xtensa_sample_controller/Kconfig"
osource "C:/ncs/sdk/zephyr/soc/cdns/dc233c/Kconfig"
osource "C:/ncs/sdk/zephyr/soc/brcm/bcmvk/Kconfig"
osource "C:/ncs/sdk/zephyr/soc/brcm/bcm2712/Kconfig"
osource "C:/ncs/sdk/zephyr/soc/brcm/bcm2711/Kconfig"
osource "C:/ncs/sdk/zephyr/soc/atmel/sam0/Kconfig"
osource "C:/ncs/sdk/zephyr/soc/atmel/sam/Kconfig"
osource "C:/ncs/sdk/zephyr/soc/aspeed/Kconfig"
osource "C:/ncs/sdk/zephyr/soc/arm/Kconfig"
osource "C:/ncs/sdk/zephyr/soc/arm/beetle/Kconfig"
osource "C:/ncs/sdk/zephyr/soc/andestech/Kconfig"
osource "C:/ncs/sdk/zephyr/soc/ambiq/Kconfig"
osource "C:/ncs/sdk/zephyr/soc/altr/zephyr_nios2f/Kconfig"
osource "C:/ncs/sdk/zephyr/soc/altr/qemu_nios2/Kconfig"
osource "C:/ncs/sdk/zephyr/soc/adi/max32/Kconfig"
```
