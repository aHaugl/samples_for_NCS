## prj.conf
```kconfig
CONFIG_STDOUT_CONSOLE=y
CONFIG_FLASH=y
CONFIG_FLASH_PAGE_LAYOUT=y
CONFIG_FLASH_MAP=y

#Adding settings for automatic including a settings partition at the end of the flash area
CONFIG_SETTINGS=y
CONFIG_SETTINGS_RUNTIME=y

#Adding bootloader just to have it
CONFIG_BOOTLOADER_MCUBOOT=y

#Adding NVS to create a custom data partition
CONFIG_FLASH=y
CONFIG_FLASH_PAGE_LAYOUT=y

CONFIG_NVS=y
CONFIG_LOG=y
CONFIG_LOG_MODE_IMMEDIATE=y
CONFIG_NVS_LOG_LEVEL_DBG=y
CONFIG_REBOOT=y
CONFIG_MPU_ALLOW_FLASH_WRITE=y
```

## src/main.c
```c
/*
 * Copyright (c) 2012-2014 Wind River Systems, Inc.
 *
 * SPDX-License-Identifier: Apache-2.0
 */

#include <stdio.h>

int main(void)
{
	printf("Hello World with custom data_storage before app and settings_storage at the end of the app!\n");

	return 0;
}
```
