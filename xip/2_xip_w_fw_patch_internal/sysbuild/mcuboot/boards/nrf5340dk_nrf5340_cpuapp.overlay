/ {
	chosen {
		zephyr,code-partition = &boot_partition;
		nordic,pm-ext-flash = &mx25r64;
	};
};

// &flash0 {
//     partitions {
//         compatible = "fixed-partitions";
//         #address-cells = <1>;
//         #size-cells = <1>;
//         nrf70_fw_partition: partition@0 {
//             label = "nrf70_fw_partition";
//             reg = <0x00000000 DT_SIZE_K(128)>;
//         };
//     };
// };